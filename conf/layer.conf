## conf/layer.conf
```bitbake
# We have a conf and classes directory, add to BBPATH
BBPATH .= ":${LAYERDIR}"

# We have recipes-* directories, add to BBFILES
BBFILES += "${LAYERDIR}/recipes-*/*/*.bb \
	${LAYERDIR}/recipes-*/*/*.bbappend"

BBFILE_COLLECTIONS += "kundo"
BBFILE_PATTERN_kundo = "^${LAYERDIR}/"
BBFILE_PRIORITY_kundo = "6"
```

## recipes-core/Conf/bblayers.conf
```bitbake
# POKY_BBLAYERS_CONF_VERSION is increased each time build/conf/bblayers.conf
# changes incompatibly
POKY_BBLAYERS_CONF_VERSION = "2"

BBPATH = "${TOPDIR}"
BBFILES ?= ""

BBLAYERS ?= " \
  /opt/yocto/poky_pyro/meta \
  /opt/yocto/poky_pyro/meta-poky \
  /opt/yocto/poky_pyro/meta-yocto-bsp \
  /opt/yocto/poky_pyro/openembedded-core/meta \
  /opt/yocto/poky_pyro/meta-openembedded/meta-oe \
  /opt/yocto/poky_pyro/meta-openembedded/meta-python \
  /opt/yocto/poky_pyro/meta-openembedded/meta-networking \
  /opt/yocto/poky_pyro/meta-odroid \
  /opt/yocto/poky_pyro/meta-kundo \
  /opt/yocto/poky_pyro/meta-oracle-java \
  /opt/yocto/poky_pyro/meta-intel-iot-middleware \
  "
```
